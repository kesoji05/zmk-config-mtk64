#include <behaviors/input_gestures_accel.dtsi>

&pointer_accel {
    input-type = <INPUT_EV_REL>;
    track-remainders;
    min-factor = <600>;
    max-factor = <2500>;
    speed-threshold = <400>;
    speed-max = <2000>;
    acceleration-exponent = <2>;
};
