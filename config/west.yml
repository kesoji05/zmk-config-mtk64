## config/west.yml
```yaml
manifest:
  remotes:
    - name: zmkfirmware
      url-base: https://github.com/zmkfirmware
    - name: caksoylar
      url-base: https://github.com/caksoylar
    - name: oleksandrmaslov
      url-base: https://github.com/oleksandrmaslov

  projects:
    - name: zmk
      remote: zmkfirmware
      revision: main
      import: app/west.yml

    - name: zmk-rgbled-widget
      remote: caksoylar
      revision: main

    - name: zmk-pointing-acceleration
      remote: oleksandrmaslov
      revision: main

  self:
    path: config
```
